## CMakeLists.txt
```
#-------------------------------------------------------------------------------
# Zephyr Example Application
#
# Copyright (c) 2021 Nordic Semiconductor ASA
# SPDX-License-Identifier: Apache-2.0

cmake_minimum_required(VERSION 3.20.0)
find_package(Zephyr REQUIRED HINTS $ENV{ZEPHYR_BASE})

project(app)

target_include_directories(app PRIVATE ${CMAKE_BINARY_DIR}/app/include src)

FILE(GLOB app_sources src/*.c)
target_sources(app PRIVATE ${app_sources})
```

## prj.conf
```kconfig
# Copyright (c) 2021 Nordic Semiconductor ASA
# SPDX-License-Identifier: Apache-2.0
#
# This file contains selected Kconfig options for the application.

# compiler
CONFIG_DEBUG_OPTIMIZATIONS=y

# console
CONFIG_CONSOLE=y

# UART console
CONFIG_SERIAL=y
CONFIG_UART_CONSOLE=y

# logging
CONFIG_LOG=y
CONFIG_APP_LOG_LEVEL_DBG=y

# ZBUS
CONFIG_ZBUS=y
CONFIG_ZBUS_LOG_LEVEL_DBG=y
CONFIG_ZBUS_CHANNEL_NAME=y
CONFIG_ZBUS_OBSERVER_NAME=y
```

## src/main.c
```c
/*
 * Copyright (c) 2023 Phytec Messtechnik GmbH
 * SPDX-License-Identifier: Apache-2.0
 */

#include <zephyr/kernel.h>
#include "evt_messages.h"
#include <zephyr/zbus/zbus.h>
#include <zephyr/drivers/gpio.h>
#include <zephyr/device.h>

#include <zephyr/logging/log.h>
LOG_MODULE_REGISTER(main, CONFIG_APP_LOG_LEVEL);

/*
 * Get button configuration from the devicetree sw0 alias.
 */
#define SW0_NODE	DT_ALIAS(sw0)

static const struct gpio_dt_spec button = GPIO_DT_SPEC_GET_OR(SW0_NODE, gpios,
							      {0});
static struct gpio_callback button_cb_data;


ZBUS_CHAN_DEFINE(bp_chan,	/* Name */
		 struct bp_msg, /* Message type */

		 NULL,	/* Validator */
		 NULL,	/* User data */
		 ZBUS_OBSERVERS(bp_handler_sub),	/* observers */
		 ZBUS_MSG_INIT(0)	/* Initial value {0} */
);

/* We are checking if the button is pressed after the debounce period */
void debounce_tmr_expiry(struct k_timer *dummy)
{
	struct bp_msg bpm = {0};
	int val;

	val = gpio_pin_get_dt(&button);
	if (val) {
		LOG_INF("Button pressed: Publish message to '%s'",
			bp_chan.name);

		bpm.pin = (uint32_t)button.pin;

		zbus_chan_pub(&bp_chan, &bpm, K_NO_WAIT);
	}
}

K_TIMER_DEFINE(debounce_tmr, debounce_tmr_expiry, NULL);

void button_pressed(const struct device *dev, struct gpio_callback *cb,
		    uint32_t pins)
{
	if (k_timer_remaining_get(&debounce_tmr)) {
		return;
	}

	k_timer_start(&debounce_tmr, K_MSEC(20), K_NO_WAIT);
}

void main(void)
{
	int ret;

	LOG_DBG("Zephyr Example Application %s\n", CONFIG_BOARD);

	if (!gpio_is_ready_dt(&button)) {
		LOG_ERR("Error: button device %s is not ready",
				button.port->name);
		return;
	}

	ret = gpio_pin_configure_dt(&button, GPIO_INPUT);
	if (ret != 0) {
		LOG_ERR("Error %d: failed to configure %s pin %d", ret,
				button.port->name, button.pin);
		return;
	}

	ret = gpio_pin_interrupt_configure_dt(&button,
					      GPIO_INT_EDGE_TO_ACTIVE);
	if (ret != 0) {
		LOG_ERR("Error %d: failed to configure interrupt on %s pin %d",
			ret, button.port->name, button.pin);
		return;
	}

	gpio_init_callback(&button_cb_data, button_pressed, BIT(button.pin));
	gpio_add_callback(button.port, &button_cb_data);
}
```

## src/led_module.c
```c
/*
 * Copyright (c) 2023 Phytec Messtechnik GmbH
 * SPDX-License-Identifier: Apache-2.0
 */

#include "evt_messages.h"
#include <zephyr/drivers/gpio.h>
#include <zephyr/zbus/zbus.h>

#include <zephyr/logging/log.h>
LOG_MODULE_REGISTER(app, CONFIG_APP_LOG_LEVEL);

/* The devicetree node identifier for the "led0" alias. */
#define LED0_NODE DT_ALIAS(led0)

/*
 * A build error on this line means your board is unsupported.
 * See the sample documentation for information on how to fix this.
 */
static const struct gpio_dt_spec led = GPIO_DT_SPEC_GET(LED0_NODE, gpios);


ZBUS_CHAN_DECLARE(bp_chan);
ZBUS_SUBSCRIBER_DEFINE(bp_handler_sub, 3);


void led_thread(void)
{
	const struct zbus_channel *chan;
	int ret;

	/* Initialize LED */
	if (!gpio_is_ready_dt(&led)) {
		return;
	}
	ret = gpio_pin_configure_dt(&led, GPIO_OUTPUT_ACTIVE);
	if (ret < 0) {
		return;
	}
	gpio_pin_set_dt(&led, 0);

	/* Wait for Messages */
	while (!zbus_sub_wait(&bp_handler_sub, &chan, K_FOREVER)) {
		struct bp_msg msg;

		zbus_chan_read(chan, &msg, K_MSEC(200));

		LOG_DBG("Rcv from '%s', Message: GPIO%d\n", chan->name,
				msg.pin);
		ret = gpio_pin_toggle_dt(&led);
		if (ret < 0) {
			return;
		}
	}
}

K_THREAD_DEFINE(led_thread_id, 1024, led_thread, NULL, NULL, NULL, 5, 0, 0);
```
